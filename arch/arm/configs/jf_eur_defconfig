## arch/arm/configs/jf_eur_defconfig
```kconfig
CONFIG_MACH_JF_EUR=y
CONFIG_EXTRA_FIRMWARE="audience-es325-fw-eur.bin"
CONFIG_EXTRA_FIRMWARE_DIR="firmware"
CONFIG_LOCALVERSION="-Google-Edition"
# CONFIG_LOCALVERSION_AUTO is not set
```

## arch/arm/configs/jfselinux_defconfig
```kconfig
CONFIG_NETWORK_SECMARK=y
CONFIG_NF_CONNTRACT_SECMARK=y
CONFIG_NETFILTER_XT_TARGET_CONNSECMARK=y
CONFIG_NETFILTER_ADVANCED=y
CONFIG_IP_NF_SECURITY=y
CONFIG_DEFAULT_SECURITY=y
```
